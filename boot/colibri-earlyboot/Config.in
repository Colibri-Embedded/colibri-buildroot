## boot/colibri-earlyboot/Config.in
```kconfig
config BR2_TARGET_COLIBRI_EARLYBOOT
	bool "Colibri-EarlyBoot"
	select BR2_PACKAGE_UTIL_LINUX
	select BR2_PACKAGE_UTIL_LINUX_LIBBLKID
	select BR2_PACKAGE_UTIL_LINUX_LIBSMARTCOLS
	select BR2_PACKAGE_UTIL_LINUX_LIBUUID
	select BR2_PACKAGE_UTIL_LINUX_BINARIES
	select BR2_PACKAGE_PARTED
	select BR2_PACKAGE_FATRESIZE
	select BR2_PACKAGE_NCURSES
	select BR2_PACKAGE_READLINE
	select BR2_PACKAGE_EARLYBOOT_UTILS
	
	help
	  Colibri EarlyBoot.

	  https://github.com/Colibri-Embedded/colibri-earlyboot
	  
if BR2_TARGET_COLIBRI_EARLYBOOT

config BR2_TARGET_COLIBRI_EARLYBOOT_CUSTOM
	bool "Custom content"
	help
	  Use custom webui and config files.

if BR2_TARGET_COLIBRI_EARLYBOOT_CUSTOM

config BR2_TARGET_COLIBRI_EARLYBOOT_CUSTOM_WEBUI
	string "Custom WebUI"
	
config BR2_TARGET_COLIBRI_EARLYBOOT_CUSTOM_CONFIG
	string "Custom earlyboot.conf"
	
config BR2_TARGET_COLIBRI_EARLYBOOT_CUSTOM_PRODUCT
	string "Custom product.sh"

endif

config BR2_TARGET_COLIBRI_EARLYBOOT_SUPPORT_EXT4
	bool "Support EXT4 filesystem"
	help
	  Add tools to handle EXT4 filesystem.

config BR2_TARGET_COLIBRI_EARLYBOOT_SUPPORT_BTRFS
	bool "Support BTRFS filesystem"
	help
	  Add tools to handle BTRFS filesystem.	  

endif
```

## fs/colibri/Config.in
```kconfig
config BR2_TARGET_ROOTFS_COLIBRI
	bool "colibri root filesystem"
	help
	  Build a colibri root filesystem
	select BR2_TARGET_ROOTFS_TAR
	select BR2_TARGET_ROOTFS_TAR_NONE

if BR2_TARGET_ROOTFS_COLIBRI

choice
	prompt "Compression algorithm"
	default BR2_TARGET_ROOTFS_COLIBRI_GZIP
	help
	  Select the squashfs compression algorithm to use when
	  generating the filesystem.

config BR2_TARGET_ROOTFS_COLIBRI_GZIP
	bool "gzip"

config BR2_TARGET_ROOTFS_COLIBRI_LZ4
	bool "lz4"

config BR2_TARGET_ROOTFS_COLIBRI_LZMA
	bool "lzma"

config BR2_TARGET_ROOTFS_COLIBRI_LZO
	bool "lzo"

config BR2_TARGET_ROOTFS_COLIBRI_XZ
	bool "xz"

endchoice
endif
```

## package/earlyboot-utils/Config.in
```kconfig
config BR2_PACKAGE_EARLYBOOT_UTILS
	bool "earlyboot-utils"
	help
	  Bundle of utils used in the colibri-earlyboot.

	  https://github.com/Colibri-Embedded/earlyboot-utils
```

## package/fake-hwclock/Config.in
```kconfig
config BR2_PACKAGE_FAKE_HWCLOCK
	bool "fake-hwclock"
	help
	  Use fake hwclock for timekeeping in case there is no RTC hardware.
```

## package/fatresize/Config.in
```kconfig
config BR2_PACKAGE_FATRESIZE
	bool "fatresize"
	depends on BR2_LARGEFILE
	select BR2_PACKAGE_PARTED
	select BR2_PACKAGE_UTIL_LINUX
	select BR2_PACKAGE_UTIL_LINUX_LIBUUID
	help
	  fatresize, The FAT16/FAT32 non-destructive resizer.

	  http://sourceforge.net/projects/fatresize/

comment "fatresize needs a largefile"
	depends on !BR2_LARGEFILE
```

## package/geos/Config.in
```kconfig
config BR2_PACKAGE_GEOS
	bool "geos"
	help
	  GEOS (Geometry Engine - Open Source) is a C++ port of the 
	  ​Java Topology Suite (JTS). As such, it aims to contain the 
	  complete functionality of JTS in C++. 

	  http://trac.osgeo.org/geos/
```

## package/libsodium/Config.in
```kconfig
config BR2_PACKAGE_LIBSODIUM
	bool "libsodium"
	help
	  Sodium is a new, easy-to-use software library for encryption, 
	  decryption, signatures, password hashing and more.

	  https://github.com/jedisct1/libsodium
```

## package/linux-firmware-extra/Config.in
```kconfig
config BR2_PACKAGE_LINUX_FIRMWARE_EXTRA
	bool "linux-firmware-extra"
	help
	  This package provides various binary firmware files (closed
	  binary blobs) for such devices like LAN, WLAN cards etc.
	  That are not part (not yet) of upstream linux-firmware.

	  https://github.com/Colibri-Embedded/linux-firmware-extra

if BR2_PACKAGE_LINUX_FIRMWARE_EXTRA


menu "WiFi firmware"

config BR2_PACKAGE_LINUX_FIRMWARE_BRCM_BCM43430
	bool "Broadcom BRCM bcm43430"
	help
	  Firmware files for the Broadcom bcm43430 WiFi/Bluetooth combo chip.

endmenu


endif # BR2_PACKAGE_LINUX_FIRMWARE_EXTRA
```

## package/mysql/Config.in
```kconfig
config BR2_PACKAGE_MYSQL
	bool "MySQL"
	depends on BR2_INSTALL_LIBSTDCPP
	depends on BR2_USE_MMU # fork()
	depends on BR2_TOOLCHAIN_HAS_THREADS
	# Toolchain is not up to the task
	depends on !BR2_avr32
	select BR2_PACKAGE_NCURSES
	select BR2_PACKAGE_READLINE
	help
	  The MySQL Open Source Database System

	  http://www.mysql.com/

if BR2_PACKAGE_MYSQL

config BR2_PACKAGE_MYSQL_SERVER
	bool "MySQL server"
	help
	  Install the MySQL server on the target.
	  
if BR2_PACKAGE_MYSQL_SERVER

config BR2_PACKAGE_MYSQL_SERVER_PARTITION
	bool "Partitioning Support"
	help
	  MySQL Partitioning Support (static).
	  
config BR2_PACKAGE_MYSQL_SERVER_ARCHIVE
	bool "Archive Storage Engine"
	help
	  Build the MySQL Archive Storage Engine plugin.
	  
config BR2_PACKAGE_MYSQL_SERVER_BLACKHOLE
	bool "Blackhole Storage Engine"
	help
	  Build the Basic Write-only Read-never tables plugin.
	  
config BR2_PACKAGE_MYSQL_SERVER_CSV
	bool "CSV Storage Engine"
	help
	  Stores tables in text CSV format (static).
	  
config BR2_PACKAGE_MYSQL_SERVER_EXAMPLE
	bool "Partitioning Support"
	help
	  Build Example for Storage Engines for developers as a plugin.
	  
config BR2_PACKAGE_MYSQL_SERVER_FEDERATED
	bool "Federated Storage Engine"
	help
	  Connects to tables on remote MySQL servers.
	  	  
config BR2_PACKAGE_MYSQL_SERVER_INNOBASE_PLUGIN
	bool "InnoDB Storage Engine"
	help
	  Transactional Tables using InnoDB.
	  
config BR2_PACKAGE_MYSQL_SERVER_MYISAMMRG
	bool "MyISAM MERGE Engine"
	help
	  Merge multiple MySQL tables into one (static).
	  
config BR2_PACKAGE_MYSQL_SERVER_NBDCLUSTER
	bool "MySQL Cluster Storage Engine"
	help
	  High Availability Clustered tables (static).

endif

endif

comment "MySQL needs a toolchain w/ C++, threads"
	depends on BR2_USE_MMU
	depends on !BR2_INSTALL_LIBSTDCPP || !BR2_TOOLCHAIN_HAS_THREADS
```

## package/python-attrs/Config.in
```kconfig
config BR2_PACKAGE_PYTHON_ATTRS
	bool "python-attrs"
	help
	  attrs is the Python package that will bring back the joy of writing
	  classes by relieving you from the drudgery of implementing object 
	  protocols. Its main goal is to help you to write concise and 
	  correct software without slowing down your code.

	  https://pypi.python.org/pypi/attrs
```

## package/python-autobahn/Config.in
```kconfig
config BR2_PACKAGE_PYTHON_AUTOBAHN
	bool "python-autobahn"
	select BR2_PACKAGE_PYTHON_TXAIO
	select BR2_PACKAGE_PYTHON_SIX
	help
	  The Autobahn project provides open-source implementations 
	  of the The WebSocket Protocol and 
	  The Web Application Messaging Protocol (WAMP) network protocols.

	  http://autobahn.ws/python/index.html
```

## package/python-click/Config.in
```kconfig
config BR2_PACKAGE_PYTHON_CLICK
	bool "python-click"
	help
	  Add some help text

	  Add the homepage url
```

## package/python-crossbar/Config.in
```kconfig
config BR2_PACKAGE_PYTHON_CROSSBAR
	bool "python-crossbar"
	select BR2_PACKAGE_PYTHON_AUTOBAHN
	select BR2_PACKAGE_PYTHON_SHUTILWHICH
	select BR2_PACKAGE_PYTHON_U_MSGPACK
	select BR2_PACKAGE_PYTHON_CBOR
	select BR2_PACKAGE_PYTHON_PYUBJSON
	select BR2_PACKAGE_PYTHON_LMDB
	select BR2_PACKAGE_PYTHON_CLICK
	select BR2_PACKAGE_PYTHON_PSUTIL
	select BR2_PACKAGE_PYTHON_PYGMENTS
	select BR2_PACKAGE_PYTHON_PYTRIE
	select BR2_PACKAGE_PYTHON_PYNACL
	select BR2_PACKAGE_PYTHON_JINJA2
	select BR2_PACKAGE_PYTHON_NETADDR
	select BR2_PACKAGE_PYTHON_WATCHDOG
	select BR2_PACKAGE_PYTHON_PYOPENSSL
	select BR2_PACKAGE_PYTHON_SETUPTOOLS
	select BR2_PACKAGE_PYTHON_SETPROCTITLE
	select BR2_PACKAGE_PYTHON_TREQ
	help
	  Crossbar.io - The Unified Application Router.

	  https://pypi.python.org/pypi/crossbar
```

## package/python-cryptography/Config.in
```kconfig
config BR2_PACKAGE_PYTHON_CRYPTOGRAPHY
	bool "python-cryptography"
	select BR2_PACKAGE_PYTHON_CFFI
	select BR2_PACKAGE_PYTHON_IDNA
	help
	  cryptography is a package which provides cryptographic recipes 
	  and primitives to Python developers.

	  https://pypi.python.org/pypi/cryptography
```

## package/python-ecdsa/Config.in
```kconfig
config BR2_PACKAGE_PYTHON_JOSE
	bool "python-jose"
	select BR2_PACKAGE_PYTHON_PYCRYPTO
	select BR2_PACKAGE_PYTHON_SIX
	help
	  Typed interactions with the GitHub API v3.

	  https://github.com/mpdavis/python-jose
```

## package/python-freetype/Config.in
```kconfig
config BR2_PACKAGE_PYTHON_FREETYPE
	bool "python-freetype"
	depends on BR2_PACKAGE_PYTHON
	select BR2_PACKAGE_FREETYPE
	help
	  Freetype python provides bindings for the FreeType library.

	  https://pypi.python.org/pypi/freetype-py
```

## package/python-idna/Config.in
```kconfig
config BR2_PACKAGE_PYTHON_IDNA
	bool "python-idna"
	help
	  Internationalized Domain Names in Applications (IDNA)

	  https://pypi.python.org/pypi/idna
```

## package/python-pathtools/Config.in
```kconfig
config BR2_PACKAGE_PYTHON_PATHTOOLS
	bool "python-pathtools"
	help
	  Pattern matching and various utilities for file systems paths.

	  https://pypi.python.org/pypi/pathtools
```

## package/python-picamera/Config.in
```kconfig
config BR2_PACKAGE_PYTHON_PICAMERA
	bool "python-picamera"
	help
	  python-picamera is pure python interface Raspberry Pi Camera 
	  module.
	  
	  https://picamera.readthedocs.io/
```

## package/python-pyasn1-modules/Config.in
```kconfig
config BR2_PACKAGE_PYTHON_PYASN1_MODULES
	bool "python-pyasn1-modules"
	help
	  A collection of ASN.1-based protocols modules.

	  https://pypi.python.org/pypi/pyasn1-modules
```

## package/python-pyasn1/Config.in
```kconfig
config BR2_PACKAGE_PYTHON_PYASN1
	bool "python-pyasn1"
	help
	  This is an implementation of ASN.1 types and codecs in 
	  Python programming language. It has been first written to support 
	  particular protocol (SNMP) but then generalized to be suitable 
	  for a wide range of protocols based on ASN.1 specification.

	  https://pypi.python.org/pypi/pyasn1
```

## package/python-pyconnman/Config.in
```kconfig
config BR2_PACKAGE_PYCONNMAN
	bool "python-pyconnman"
	depends on BR2_PACKAGE_PYTHON || BR2_PACKAGE_PYTHON3
	select BR2_CONNMAN
	help
	  Python bindings for connman

	  https://pypi.python.org/pypi/pyconnman/
```

## package/python-pycparser/Config.in
```kconfig
config BR2_PACKAGE_PYTHON_PYCPARSER
	bool "python-pycparser"
	help
	  pycparser is a complete parser of the C language, written in
	  pure Python using the PLY parsing library. It parses C code into 
	  an AST and can serve as a front-end for C compilers or analysis tools.

	  https://pypi.python.org/pypi/pycparser
```

## package/python-pygithub/Config.in
```kconfig
config BR2_PACKAGE_PYTHON_GITHUB
	bool "python-pygithub"
	select BR2_PACKAGE_PYTHON_JOSE
	help
	  Typed interactions with the GitHub API v3.

	  https://github.com/PyGithub/PyGithub
```

## package/python-pynacl/Config.in
```kconfig
config BR2_PACKAGE_PYTHON_PYNACL
	bool "python-pynacl"
	help
	  Python binding to the Networking and Cryptography (NaCl) library

	  https://pypi.python.org/pypi/PyNaCl
```
