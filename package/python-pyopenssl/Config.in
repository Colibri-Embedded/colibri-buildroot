## package/python-pyopenssl/Config.in
```kconfig
config BR2_PACKAGE_PYTHON_PYOPENSSL
	bool "python-pyopenssl"
	select BR2_PACKAGE_OPENSSL
	select BR2_PACKAGE_PYTHON_SIX
	select BR2_PACKAGE_PYTHON_CRYPTOGRAPHY
	help
	  Python wrapper module around the OpenSSL library

	  https://pypi.python.org/pypi/pyOpenSSL
```

## package/python-pyro4/Config.in
```kconfig
config BR2_PACKAGE_PYTHON_PYRO
	bool "python-pyro4"
	select BR2_PACKAGE_PYTHON_SERPENT
	select BR2_PACKAGE_PYTHON_SELECTORS34
	depends on BR2_PACKAGE_PYTHON
	help
	  python-pyro is a Python library stands for PYthon Remote Objects.
	  It is an advanced and powerful Distributed Object Technology system
	  written entirely in Python, that is designed to be very easy to use..

	  https://pypi.python.org/pypi/Pyro4/
```

## package/python-pyubjson/Config.in
```kconfig
config BR2_PACKAGE_PYTHON_PYUBJSON
	bool "python-pyubjson"
	help
	  Universal Binary JSON encoder/decoder.
	  
	  https://pypi.python.org/pypi/py-ubjson/0.8.5
```

## package/python-pyyaml/Config.in
```kconfig
config BR2_PACKAGE_PYTHON_PYYAML
	bool "python-pyyaml"
	depends on BR2_PACKAGE_PYTHON
	select BR2_PACKAGE_LIBYAML
	help
	  PyYAML is a YAML parser and emitter for Python.

	  http://pyyaml.org/wiki/PyYAML
```

## package/python-rpi-gpio/Config.in
```kconfig
config BR2_PACKAGE_PYTHON_RPI_GPIO
	bool "python-rpi.gpio"
	help
	  This package provides a class to control the GPIO on a Raspberry Pi.

	  https://pypi.python.org/pypi/RPi.GPIO
```

## package/python-scipy/Config.in
```kconfig
config BR2_PACKAGE_PYTHON_SCIPY
	bool "python-scipy"
	# Numpy has some CPU specific code
	select BR2_PACKAGE_PYTHON_NUMPY
	select BR2_PACKAGE_CLAPACK
	depends on BR2_INSTALL_LIBGFORTRAN
	# numpy needs fenv.h. Available for all architectures in
	# glibc, but only for x86 and x86-64 in uClibc.
	depends on !BR2_TOOLCHAIN_USES_UCLIBC || BR2_i386 || BR2_x86_64
	help
	  SciPy is an Python ecosystem for mathematics, science and 
	  engineering.

	  http://www.scipy.org/
```

## package/python-selectors34/Config.in
```kconfig
config BR2_PACKAGE_PYTHON_SELECTORS34
	bool "python-serpent"
	depends on BR2_PACKAGE_PYTHON
	help
	  python-selectors34 is a backport of the selectors module 
	  from Python 3.4. 
	  
	  https://pypi.python.org/pypi/selectors34/
```

## package/python-serpent/Config.in
```kconfig
config BR2_PACKAGE_PYTHON_SERPENT
	bool "python-serpent"
	depends on BR2_PACKAGE_PYTHON
	help
	  python-serpent is a simple serialization library.
	  
	  https://pypi.python.org/pypi/serpent/
```

## package/python-service-identity/Config.in
```kconfig
config BR2_PACKAGE_PYTHON_SERVICE_IDENTITY
	bool "python-service-identity"
	select BR2_PACKAGE_PYTHON_PYOPENSSL
	select BR2_PACKAGE_PYTHON_PYASN1
	select BR2_PACKAGE_PYTHON_PYASN1_MODULES
	select BR2_PACKAGE_PYTHON_ATTRS
	help
	  Service identity verification for pyOpenSSL.

	  https://pypi.python.org/pypi/service_identity
```

## package/python-setproctitle/Config.in
```kconfig
config BR2_PACKAGE_PYTHON_SETPROCTITLE
	bool "python-setproctitle"
	help
	  The setproctitle module allows a process to change its title 
	  (as displayed by system tools such as ps and top).

	  https://pypi.python.org/pypi/setproctitle
```

## package/python-shapely/Config.in
```kconfig
config BR2_PACKAGE_PYTHON_SHAPELY
	bool "python-shapely"
	select BR2_PACKAGE_GEOS
	help
	  Shapely is a Python package for manipulation and analysis of planar 
	  geometric objects. It is based on the widely deployed GEOS library.

	  https://pypi.python.org/pypi/Shapely
```

## package/python-six/Config.in
```kconfig
config BR2_PACKAGE_PYTHON_SIX
	bool "python-six"
	depends on BR2_PACKAGE_PYTHON
	help
	  Six is a Python 2 and 3 compatibility library. It provides
	  utility functions for smoothing over the differences between
	  the Python versions with the goal of writing Python code that
	  is compatible on both Python versions.

	  http://pythonhosted.org/six
```

## package/python-treq/Config.in
```kconfig
config BR2_PACKAGE_PYTHON_TREQ
	bool "python-treq"
	select BR2_PACKAGE_PYTHON_PYOPENSSL
	select BR2_PACKAGE_PYTHON_REQUESTS
	select BR2_PACKAGE_PYTHON_SERVICE_IDENTIFY
	select BR2_PACKAGE_PYTHON_TWISTED
	help
	  A requests-like API built on top of twisted.web's Agent

	  https://pypi.python.org/pypi/treq
```

## package/python-txaio/Config.in
```kconfig
config BR2_PACKAGE_PYTHON_TXAIO
	bool "python-txaio"
	help
	  txaio is a helper library for writing code that runs unmodified 
	  on both Twisted and asyncio / Trollius.

	  https://pypi.python.org/pypi/txaio
```

## package/python-txdbus/Config.in
```kconfig
config BR2_PACKAGE_TXDBUS
	bool "python-txdbus"
	depends on BR2_PACKAGE_PYTHON || BR2_PACKAGE_PYTHON3
	select BR2_PACKAGE_TWISTED
	help
	  Python bindings for D-Bus

	  https://pypi.python.org/pypi/txdbus
```

## package/python-u-msgpack/Config.in
```kconfig
config BR2_PACKAGE_PYTHON_U_MSGPACK
	bool "python-u-msgpack"
	help
	  A portable, lightweight MessagePack serializer and deserializer written in pure Python.

	  https://pypi.python.org/pypi/u-msgpack-python
```

## package/python-watchdog/Config.in
```kconfig
config BR2_PACKAGE_PYTHON_WATCHDOG
	bool "python-watchdog"
	select BR2_PACKAGE_PYTHON_PATHTOOLS
	select BR2_PACKAGE_PYTHON_PYYAML
	help
	  Python API and shell utilities to monitor file system events.

	  https://pypi.python.org/pypi/watchdog
```

## package/python-ws4py/Config.in
```kconfig
config BR2_PACKAGE_PYTHON_WS4PY
	bool "python-ws4py"
	depends on BR2_PACKAGE_PYTHON
	help
	  WebSocket client and server library for Python 2 and 3 as well as PyPy.

	  https://pypi.python.org/pypi/ws4py
```

## package/rpi-firmware/Config.in
```kconfig
config BR2_PACKAGE_RPI_FIRMWARE
	bool "rpi-firmware"
	depends on BR2_arm
	help
	  RaspberryPi Firmware
	  Pre-compiled binaries of the current bootloader and GPU firmware

	  https://github.com/raspberrypi/firmware

if BR2_PACKAGE_RPI_FIRMWARE

choice
	bool "Firmware to boot"
	default BR2_PACKAGE_RPI_FIRMWARE_DEFAULT
	help
	  There are three different firmware files:
	    - the default firmware, that enables standard GPU features;
	    - the extended firmware, that enables additional GPU features
	      (eg. more audio/video codecs);
	    - the cut-down firmware, for emergency situations, with only
	      features required to boot a Linux kernel.

config BR2_PACKAGE_RPI_FIRMWARE_DEFAULT
	bool "default"
	help
	  The default firmware, that enables standard GPU features.

config BR2_PACKAGE_RPI_FIRMWARE_X
	bool "extended ('x', more codecs)"
	help
	  The extended firmware, that enables additional GPU features
	  (eg. more audio/video codecs).

config BR2_PACKAGE_RPI_FIRMWARE_CD
	bool "cut-down ('cd', emergency)"
	help
	  The cut-down firmware, for emergency situations, with only
	  features required to boot a Linux kernel.

endchoice

config BR2_PACKAGE_RPI_FIRMWARE_BOOT
	string
	default ""      if BR2_PACKAGE_RPI_FIRMWARE_DEFAULT
	default "_x"    if BR2_PACKAGE_RPI_FIRMWARE_X
	default "_cd"   if BR2_PACKAGE_RPI_FIRMWARE_CD

config BR2_PACKAGE_RPI_FIRMWARE_CUSTOM_CONFIG
	bool "Custom config files"
	help
	  Use custom config files.
	  
if BR2_PACKAGE_RPI_FIRMWARE_CUSTOM_CONFIG

config BR2_PACKAGE_RPI_FIRMWARE_CMDLINE_TXT
	string "cmdline.txt"
	
config BR2_PACKAGE_RPI_FIRMWARE_CONFIG_TXT
	string "config.txt"

endif

config BR2_PACKAGE_RPI_FIRMWARE_INSTALL_DTBS
	bool "Install Device Tree Blobs (DTBs)"
	help
	  Say 'y' here if you want to boot your kernel that has support
	  for the device tree.

	  Note that the defconfig files in the Raspberry Pi fork of the
	  Linux kernel do not enable support for the Device Tree. You'll
	  have to provide your own Linux config or defconfig file with
	  device tree enabled, to make use of those DTBs.

config BR2_PACKAGE_RPI_FIRMWARE_USE_CUSTOM_VERSION
	bool "Custom firmware version"
	help 
		If you need a specific firmware version instead of a buildroot
		pre-configured one, select this option an input the version
		that can be found under rpi-firmware github releases
		
if BR2_PACKAGE_RPI_FIRMWARE_USE_CUSTOM_VERSION
	config BR2_PACKAGE_RPI_FIRMWARE_CUSTOM_VERSION
	string "1.yyyymmdd"
endif

endif # BR2_PACKAGE_RPI_FIRMWARE
```

## package/wampcc/Config.in
```kconfig
config BR2_PACKAGE_WAMPCC
	bool "wampcc"
	help
	  WAMP C++ library that provides the WAMP basic profile for client 
	  roles and also a lightweight implementation of a WAMP router / dealer. 

	  https://github.com/darrenjs/wampcc
```
